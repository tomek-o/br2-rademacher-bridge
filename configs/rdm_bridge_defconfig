## configs/rdm_bridge_defconfig
```kconfig
# Minimal Buildroot system for the Rademacher bridge (Raspberry Pi Zero, BCM2835 / ARM1176JZF-S)
BR2_arm=y
BR2_arm1176jzf_s=y
BR2_TOOLCHAIN_EXTERNAL=y
BR2_TOOLCHAIN_EXTERNAL_BOOTLIN_ARMV6_EABIHF_GLIBC_STABLE=y
BR2_GLOBAL_PATCH_DIR="$(BR2_EXTERNAL_RDM_BRIDGE_PATH)/patches"
BR2_DOWNLOAD_FORCE_CHECK_HASHES=y

# System
BR2_TARGET_GENERIC_HOSTNAME="bridge"
BR2_TARGET_GENERIC_ISSUE="Rademacher bridge (Buildroot)"
BR2_INIT_SYSV=y
BR2_ROOTFS_DEVICE_CREATION_DYNAMIC_MDEV=y
BR2_TARGET_GENERIC_ROOT_PASSWD="tomeko"
BR2_TARGET_GENERIC_GETTY_PORT="tty1"
BR2_ROOTFS_USERS_TABLES="$(BR2_EXTERNAL_RDM_BRIDGE_PATH)/board/rdm_bridge/users.table"
BR2_ROOTFS_OVERLAY="$(BR2_EXTERNAL_RDM_BRIDGE_PATH)/board/rdm_bridge/overlay"
BR2_ROOTFS_POST_BUILD_SCRIPT="$(BR2_EXTERNAL_RDM_BRIDGE_PATH)/board/rdm_bridge/post-build.sh"
BR2_ROOTFS_POST_IMAGE_SCRIPT="$(BR2_EXTERNAL_RDM_BRIDGE_PATH)/board/rdm_bridge/post-image.sh"

# Kernel (mainline, bcm2835_defconfig + fragment, custom DTS with the KS8851)
BR2_LINUX_KERNEL=y
BR2_LINUX_KERNEL_CUSTOM_VERSION=y
BR2_LINUX_KERNEL_CUSTOM_VERSION_VALUE="6.12.115"
BR2_LINUX_KERNEL_DEFCONFIG="bcm2835"
BR2_LINUX_KERNEL_CONFIG_FRAGMENT_FILES="$(BR2_EXTERNAL_RDM_BRIDGE_PATH)/board/rdm_bridge/linux.fragment"
BR2_LINUX_KERNEL_DTS_SUPPORT=y
BR2_LINUX_KERNEL_CUSTOM_DTS_PATH="$(BR2_EXTERNAL_RDM_BRIDGE_PATH)/board/rdm_bridge/bcm2835-rpi-zero-bridge.dts"

# Boot: Raspberry Pi GPU firmware loads the kernel directly (no U-Boot)
BR2_PACKAGE_RPI_FIRMWARE=y
BR2_PACKAGE_RPI_FIRMWARE_BOOTCODE_BIN=y
BR2_PACKAGE_RPI_FIRMWARE_VARIANT_PI=y
BR2_PACKAGE_RPI_FIRMWARE_CONFIG_FILE="$(BR2_EXTERNAL_RDM_BRIDGE_PATH)/board/rdm_bridge/config.txt"
BR2_PACKAGE_RPI_FIRMWARE_CMDLINE_FILE="$(BR2_EXTERNAL_RDM_BRIDGE_PATH)/board/rdm_bridge/cmdline.txt"

# Packages
BR2_PACKAGE_OPENSSH=y
BR2_PACKAGE_BUSYBOX_CONFIG_FRAGMENT_FILES="$(BR2_EXTERNAL_RDM_BRIDGE_PATH)/board/rdm_bridge/busybox.fragment"
BR2_PACKAGE_MC=y
BR2_PACKAGE_LIBCURL=y
BR2_PACKAGE_LIBCURL_CURL=y
BR2_PACKAGE_LIBCURL_OPENSSL=y
BR2_PACKAGE_CA_CERTIFICATES=y
BR2_PACKAGE_NANO=y
BR2_PACKAGE_HTOP=y
BR2_PACKAGE_ETHTOOL=y
BR2_PACKAGE_TCPDUMP=y
BR2_PACKAGE_RSYNC=y
BR2_PACKAGE_SUDO=y
BR2_PACKAGE_NCURSES=y
BR2_PACKAGE_ALSA_UTILS=y
BR2_PACKAGE_ALSA_UTILS_APLAY=y
BR2_PACKAGE_ALSA_UTILS_AMIXER=y
BR2_PACKAGE_ALSA_UTILS_ALSAMIXER=y
BR2_PACKAGE_LIGHTTPD=y
BR2_PACKAGE_LIGHTTPD_OPENSSL=y
BR2_PACKAGE_LIBOPENSSL_BIN=y
BR2_PACKAGE_LIGHTTPD=y
BR2_PACKAGE_LIGHTTPD_OPENSSL=y
# First-boot expansion of the root partition to the whole card (sfdisk + resize2fs)
BR2_PACKAGE_UTIL_LINUX=y
BR2_PACKAGE_UTIL_LINUX_BINARIES=y
BR2_PACKAGE_E2FSPROGS=y
BR2_PACKAGE_E2FSPROGS_RESIZE2FS=y

# Images: boot (FAT) + rootfs (ext4) -> sdcard.img
BR2_TARGET_ROOTFS_EXT2=y
BR2_TARGET_ROOTFS_EXT2_4=y
BR2_TARGET_ROOTFS_EXT2_SIZE="128M"
BR2_PACKAGE_HOST_DOSFSTOOLS=y
BR2_PACKAGE_HOST_GENIMAGE=y
BR2_PACKAGE_HOST_MTOOLS=y
```
